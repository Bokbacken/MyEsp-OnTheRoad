## main/Kconfig.projbuild
```kconfig
menu "OnTheRoad hardware profile"

    choice OTR_HW_PROFILE
        prompt "Board profile"
        default OTR_HW_PROFILE_P4_43 if IDF_TARGET_ESP32P4
        default OTR_HW_PROFILE_ES3C35P
        help
            Selects the board. Each profile is bound to its chip target, so the profile follows
            `idf.py set-target`.

        config OTR_HW_PROFILE_ES3C35P
            bool "ES3C35P (ESP32-S3, ST77922 QSPI 320x480)"
            depends on IDF_TARGET_ESP32S3
        config OTR_HW_PROFILE_P4_43
            bool "P4_43 (Waveshare ESP32-P4-WIFI6-Touch-LCD-4.3, ST7701 MIPI-DSI 480x800)"
            depends on IDF_TARGET_ESP32P4
    endchoice

endmenu

menu "OnTheRoad diagnostics"
    config OTR_SD_50MHZ_EXPERIMENT
        bool "Experimental 50 MHz SD card and C6 SDIO clocks"
        depends on OTR_HW_PROFILE_P4_43
        default n
        help
            Requires ESP_HOSTED_HOST_SDIO_CLK_KHZ=50000. Raises both P4
            SDMMC slots to 50 MHz using the 200 MHz SDIO clock source.
            Verifies negotiated and actual clocks. Keep disabled for
            normal 40 MHz builds; hardware stability is not established.

    config OTR_SD_IO_DIAGNOSTICS
        bool "Sample SD card transactions without accessing the card"
        default n
        help
            Records command progress in RAM and reports it once per second
            while SD transactions are active. Does not instrument the C6 radio
            slot or change clocks, timeouts, task priorities or watchdog limits.
endmenu
```
