// adv_export.cpp - host tool. Emits faithful .adv files for ALL built-in adventures
// straight from the engine's REAL data (Otr::WORLDS, Otr::JOSEPH_ROAD_DEF) and the
// compiled story scripts (VILLAGE_STORY, JOSEPH_STORY). Because the text is generated
// from the exact structures the firmware runs, the generated .adv round-trip back into
// the engine (see tests/test_adv_parser.cpp, which parses every generated file).
//
// Build & run (writes under the paths given, default: the repo tree). See
// tests/test_adv_parser.cpp for the exact compile line; it links the same TUs.
//   g++ -std=c++17 ... tools/adv_export.cpp <maps + stories + otr_world.cpp>
//       -o tools/adv_export && ./tools/adv_export
//
// Output:
//   docs/adventures/generated/<file>.adv          (repo examples, flat)
//   sdcard_bundle/otr/adventure/<dir>/NN_*.adv    (SD-ready, one dir per adventure)
//   sdcard_bundle/otr/adventure/<dir>/bitmaps/    (empty dir for optional PNG overrides)
#include <cstdio>
#include <cstring>
#include <string>
#include <sys/stat.h>
#include <sys/types.h>
#include <vector>

#include "otr_maps.h"
#include "otr_stories.h"
#include "otr_story.h"
#include "otr_world.h"

using namespace Otr;
using namespace Otr::Story;

static void mkpath(const std::string &p)
{
    std::string cur;
    for (size_t i = 0; i < p.size(); i++) {
        cur.push_back(p[i]);
        if (p[i] == '/' || i + 1 == p.size()) mkdir(cur.c_str(), 0755);
    }
}

// Covering-object glyph a treasure hides under, by the covering object actually on
// that cell in the map rows (so the generated comment is accurate).
static std::string objName(Obj o)
{
    switch (o) {
    case Obj::KEY: return "key";
    case Obj::GEM: return "gem";
    case Obj::BOAT: return "boat";
    case Obj::POTION: return "potion";
    case Obj::HEART: return "heart";
    case Obj::SUIT: return "suit";
    case Obj::LIFE: return "life";
    case Obj::BOMB3: return "bomb3";
    case Obj::BOMB4: return "bomb4";
    default: return "gem";
    }
}

struct Meta {
    std::string file;       // level filename (NN_*.adv)
    std::string titleSv, titleEn, descSv, descEn, author, carry, reset;
};

static void emitText(std::string &s, const char *key, const Text &t)
{
    if (t.s[0]) { s += key; s += ".sv: "; s += t.s[0]; s += "\n"; }
    if (t.s[1]) { s += key; s += ".en: "; s += t.s[1]; s += "\n"; }
}

static std::string emitAdv(const Meta &m, const MapDef &def, const Script *sc, bool firstLevel, int worldId)
{
    std::string s;
    s += "# Generated by tools/adv_export.cpp from the compiled engine data - do not hand-edit.\n";
    s += "# This .adv is the REAL built-in adventure expressed in the authoring format.\n\n";
    s += "@meta\n";
    s += "id: " + m.file.substr(0, m.file.rfind('.')) + "\n";
    s += "world: " + std::to_string(worldId) + "\n";        // the adventure's world id
    s += "map_id: " + std::to_string((int)def.id) + "\n\n"; // this map's stable save id

    if (firstLevel) {
        s += "@about\n";
        s += "title.sv: " + m.titleSv + "\n";
        s += "title.en: " + m.titleEn + "\n";
        s += "desc.sv: " + m.descSv + "\n";
        s += "desc.en: " + m.descEn + "\n";
        s += "author: " + m.author + "\n\n";
    }

    const Rules &r = def.rules;
    s += "@rules\n";
    s += "start_energy: " + std::to_string(r.startEnergy) + "\n";
    s += "energy_cap: " + std::to_string(r.energyCap) + "\n";
    s += std::string("lives: ") + (r.lives == LIVES_INFINITE ? "infinite" : std::to_string(r.lives)) + "\n";
    s += "lava_damage: " + std::to_string(r.lavaDamage) + "\n";
    s += "mine_damage: " + std::to_string(r.mineDamage) + "\n";
    s += "suit_base_steps: " + std::to_string(r.suitBaseSteps) + "\n";
    s += "suit_per_extra_max: " + std::to_string(r.suitPerExtraMax) + "\n";
    s += "potion_default: " + std::to_string(r.potionDefault) + "\n";
    s += "heart_default: " + std::to_string(r.heartDefault) + "\n";
    s += std::string("fog: ") + (r.fog ? "true" : "false") + "\n";
    if (!m.carry.empty()) s += "carry: " + m.carry + "\n";
    if (!m.reset.empty()) s += "reset: " + m.reset + "\n";
    s += "\n";

    s += "@map\n";
    for (int y = 0; y < def.h; y++) { s += def.rows[y]; s += "\n"; }
    s += "\n";

    if (def.treasures && def.treasureCount > 0) {
        s += "@treasures\n";
        s += "# x y item [amount]  (hidden under the covering object on that cell)\n";
        for (int i = 0; i < def.treasureCount; i++) {
            const Treasure &t = def.treasures[i];
            s += std::to_string(t.x) + " " + std::to_string(t.y) + " " + objName(t.item) +
                 " " + std::to_string(t.amount) + "\n";
        }
        s += "\n";
    }

    if (sc) {
        if (sc->flagCount) {
            s += "@flags\n";
            for (int i = 0; i < sc->flagCount; i++) { s += sc->flags[i]; s += "\n"; }
            s += "\n";
        }
        if (sc->counterCount) {
            s += "@counters\n";
            for (int i = 0; i < sc->counterCount; i++) { s += sc->counters[i]; s += "\n"; }
            s += "\n";
        }
        if (sc->itemCount) {
            s += "@items\n";
            for (int i = 0; i < sc->itemCount; i++) {
                const Named &n = sc->items[i];
                s += std::string(n.id) + " : " + (n.name.s[0] ? n.name.s[0] : "") +
                     " : " + (n.name.s[1] ? n.name.s[1] : "") + "\n";
            }
            s += "\n";
        }
        if (sc->questCount) {
            s += "@quests\n";
            for (int i = 0; i < sc->questCount; i++) {
                const Named &n = sc->quests[i];
                s += std::string(n.id) + " : " + (n.name.s[0] ? n.name.s[0] : "") +
                     " : " + (n.name.s[1] ? n.name.s[1] : "") + "\n";
            }
            s += "\n";
        }
        for (int i = 0; i < sc->npcCount; i++) {
            const Npc &n = sc->npcs[i];
            s += std::string("@npc ") + n.id + "\n";
            s += std::string("name: ") + (n.name.s[0] ? n.name.s[0] : "");
            if (n.name.s[1]) { s += " | "; s += n.name.s[1]; }
            s += "\n";
            s += "look: " + std::to_string(n.look) + "\n";
            s += "num: " + std::to_string(n.num) + "\n\n";
        }
        for (int i = 0; i < sc->nodeCount; i++) {
            const Node &nd = sc->nodes[i];
            s += std::string("@node ") + nd.id + "\n";
            if (nd.cond) { s += "cond: "; s += nd.cond; s += "\n"; }
            if (nd.speaker) { s += "speaker: "; s += nd.speaker; s += "\n"; }
            if (nd.ref) { s += "ref: "; s += nd.ref; s += "\n"; }
            if (nd.quote) { s += "quote: "; s += nd.quote; s += "\n"; }
            if (nd.effects) { s += "effects: "; s += nd.effects; s += "\n"; }
            emitText(s, "text", nd.text);
            for (int c = 0; c < MAX_CHOICES; c++) {
                const Choice &ch = nd.choices[c];
                if (!ch.text.s[0]) continue;
                s += "choice: ";
                s += ch.text.s[0];
                if (ch.text.s[1]) { s += " | "; s += ch.text.s[1]; }
                s += " => ";
                s += ch.next ? ch.next : "END";
                if (ch.cond) { s += " ?? "; s += ch.cond; }
                if (ch.effects) { s += " !! "; s += ch.effects; }
                if (ch.hint.s[0]) {
                    s += " ~~ ";
                    s += ch.hint.s[0];
                    if (ch.hint.s[1]) { s += " | "; s += ch.hint.s[1]; }
                }
                s += "\n";
            }
            s += "\n";
        }
    }
    return s;
}

static void writeFile(const std::string &path, const std::string &body)
{
    FILE *f = fopen(path.c_str(), "wb");
    if (!f) { std::printf("ERROR: cannot write %s\n", path.c_str()); return; }
    fwrite(body.data(), 1, body.size(), f);
    fclose(f);
    std::printf("wrote %s (%zu bytes)\n", path.c_str(), body.size());
}

int main(int argc, char **argv)
{
    const std::string root = argc > 1 ? argv[1] : ".";
    const std::string gen = root + "/docs/adventures/generated";
    const std::string bundle = root + "/sdcard_bundle/otr/adventure";
    mkpath(gen);

    struct AdvOut {
        std::string dir;         // sd subdir = stable adventure id
        int worldId;
        std::vector<Meta> metas; // one per level, in filename order
        std::vector<const MapDef *> maps;
        const Script *script;
    };

    static const MapDef josephCamp = WORLDS[WORLD_JOSEPH - 1];

    std::vector<AdvOut> advs = {
        {"testvarlden", WORLD_TEST,
         {{"01_testvarlden.adv", "Testvärlden", "Test world",
           "Stor sandlåda som visar alla mekaniker: stenar, lådor, lava, båtar och dolda skatter.",
           "A big sandbox showing every mechanic: rocks, crates, lava, boats and hidden treasures.",
           "MyEsp-OnTheRoad", "", ""}},
         {&WORLDS[WORLD_TEST - 1]}, nullptr},
        {"minfaltet", WORLD_MINES,
         {{"01_minfaltet.adv", "Minfältet", "The minefield",
           "Minsvepar-äventyr i dimma. Avtäck marken, flagga minor och ta dig till utgången.",
           "A minesweeper adventure in fog. Uncover the ground, flag mines and reach the exit.",
           "MyEsp-OnTheRoad", "", ""}},
         {&WORLDS[WORLD_MINES - 1]}, nullptr},
        {"byn", WORLD_VILLAGE,
         {{"01_byn.adv", "Byn", "The Village",
           "En pratig by: möt folk, lös en liten tjänst och öppna vägen vidare.",
           "A chatty village: meet folk, run a small errand and open the way onward.",
           "MyEsp-OnTheRoad", "", ""}},
         {&WORLDS[WORLD_VILLAGE - 1]}, &VILLAGE_STORY},
        {"josef", WORLD_JOSEPH,
         {{"01_lager.adv", "Josef - Drömmaren", "Joseph - The Dreamer",
           "1 Mosebok 37, kapitel 1. Hjälp till i Jakobs läger i Hebron och ge Josef manteln.",
           "Genesis 37, chapter 1. Help in Jacob's camp at Hebron and give Joseph the robe.",
           "MyEsp-OnTheRoad", "energy, maxenergy, items, lives", "suit"},
          {"02_vag.adv", "Josef - Vägen till Dotan", "Joseph - The road to Dothan",
           "Andra nivån: karavanvägen mot Dotan, den tomma cisternen och köpmannen.",
           "Second level: the caravan road to Dothan, the empty cistern and the merchant.",
           "MyEsp-OnTheRoad", "energy, maxenergy, items, lives", "suit"}},
         {&josephCamp, &JOSEPH_ROAD_DEF}, &JOSEPH_STORY},
    };

    for (const AdvOut &a : advs) {
        const std::string advDir = bundle + "/" + a.dir;
        mkpath(advDir + "/bitmaps");
        for (size_t li = 0; li < a.metas.size(); li++) {
            std::string body = emitAdv(a.metas[li], *a.maps[li], a.script, li == 0, a.worldId);
            writeFile(advDir + "/" + a.metas[li].file, body);
            writeFile(gen + "/" + a.dir + "_" + a.metas[li].file, body);
        }
    }
    std::printf("done\n");
    return 0;
}
